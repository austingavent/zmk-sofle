/ {
    chosen {
        zmk,kscan = &mock_kscan;
        zmk,matrix_transform = &default_transform;
    };

    mock_kscan: kscan_0 {
        compatible = "zmk,kscan-mock";
        columns = <0>;
        rows = <0>;
        events = <0>;
    };

    default_transform: keymap_transform_0 {
        compatible = "zmk,matrix-transform";
        columns = <14>;
        rows = <5>;
        
        // CORRECTED: Proper 64-key layout matching original board
        // 14 columns x 5 rows, with column 6 reserved for joystick/encoder
        map = <
            0  1  2  3  4  5    7  8  9 10 11 12 13
           14 15 16 17 18 19   21 22 23 24 25 26 27
           28 29 30 31 32 33   35 36 37 38 39 40 41
           42 43 44 45 46 47   49 50 51 52 53 54 55
           56 57 58 59 60 61   63 64 65 66 67 68
        >;
    };
};
