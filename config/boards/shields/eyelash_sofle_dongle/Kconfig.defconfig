## config/boards/shields/eyelash_sofle_dongle/Kconfig.defconfig
```kconfig
if SHIELD_EYELASH_SOFLE_DONGLE

config ZMK_KEYBOARD_NAME
    default "Eyelash Dongle"

config ZMK_SPLIT_ROLE_CENTRAL
    default y

config ZMK_SPLIT
    default y

# For left and right halves
config ZMK_SPLIT_BLE_CENTRAL_PERIPHERALS
    default 2

# 2 peripherals + 5 BT profiles = 7
config BT_MAX_CONN
    default 7

config BT_MAX_PAIRED
    default 7

endif
```
